## config/boards/shields/mokulua/Kconfig.defconfig
```kconfig
if SHIELD_MOKULUA_LEFT

config ZMK_KEYBOARD_NAME
	default "Mokulua"

config ZMK_SPLIT_BLE_ROLE_CENTRAL
	default y

endif

if SHIELD_MOKULUA_LEFT || SHIELD_MOKULUA_RIGHT

config ZMK_SPLIT
	default y

endif
```
